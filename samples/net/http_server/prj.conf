## CMakeLists.txt
```
# SPDX-License-Identifier: Apache-2.0

cmake_minimum_required(VERSION 3.13.1)
include($ENV{ZEPHYR_BASE}/cmake/app/boilerplate.cmake NO_POLICY_SCOPE)
project(http_server)

FILE(GLOB app_sources src/*.c)
target_sources(app PRIVATE ${app_sources})
zephyr_include_directories(${APPLICATION_SOURCE_DIR}/src/)
```

## sample.yaml
```
sample:
  name: http server based on FXOS8700 Accelerometer/Magnetometer Sensor
tests:
  sample.net.http_server:
    harness: sensor
    platform_whitelist: frdm_k64f
    tags: sensors
    depends_on: i2c gpio
    extra_configs:
      - CONFIG_FXOS8700_PULSE=y
      - CONFIG_FXOS8700_PULSE_INT1=y
      - CONFIG_FXOS8700_MOTION=y
      - CONFIG_FXOS8700_MOTION_INT1=y
      - CONFIG_FXOS8700_PM_LOW_POWER=y
```

## prj.conf
```kconfig
CONFIG_STDOUT_CONSOLE=y
CONFIG_LOG=y
CONFIG_I2C=y
CONFIG_SENSOR=y
CONFIG_FXOS8700=y
CONFIG_SENSOR_LOG_LEVEL_DBG=y

CONFIG_FXOS8700_MODE_HYBRID=y
CONFIG_FXOS8700_TEMP=y
CONFIG_FXOS8700_PM_LOW_POWER=y
CONFIG_FXOS8700_TRIGGER_OWN_THREAD=y

CONFIG_NETWORKING=y
CONFIG_NET_IPV6=n
CONFIG_NET_IPV4=y
CONFIG_NET_ARP=y
CONFIG_NET_UDP=y
CONFIG_NET_DHCPV4=y

CONFIG_TEST_RANDOM_GENERATOR=y

CONFIG_INIT_STACKS=y

CONFIG_NET_MGMT=y
CONFIG_NET_MGMT_EVENT=y

CONFIG_NET_LOG=y
CONFIG_LOG=y

CONFIG_SLIP_STATISTICS=n
CONFIG_NET_SHELL=y

CONFIG_NET_L2_ETHERNET=y
CONFIG_ETH_E1000=y
CONFIG_PCIE=y

#CONFIG_ETHERNET_LOG_LEVEL_DBG=y
```

## src/main.c
```c
/*
 *
 *
 *
 * SPDX-License-Identifier: Apache-2.0
 */

#include <zephyr.h>
#include <stdio.h>

/* http_server sample based headers */
#include <app_sensor.h>

void main(void)
{
	int ret;
	ret = app_sensor_init();
	if ( ret != 0 ){
		printf("error");
	}

	printf("init done");

	while (1) {
		app_sensor_loop();
	}
}
```

## src/app_sensor.c
```c
/*
 *
 *
 *
 * SPDX-License-Identifier: Apache-2.0
*/

#include <zephyr.h>
#include <drivers/sensor.h>
#include <stdio.h>

K_SEM_DEFINE(sem, 0, 1);	/* starts off "not available" */

static struct sensor_value accel[3];
static struct sensor_value magn[3];
static struct sensor_value temp;
static struct device *dev;

static void trigger_handler(struct device *dev, struct sensor_trigger *trigger)
{
	ARG_UNUSED(trigger);

	printf("trigger");
	/* Always fetch the sample to clear the data ready interrupt in the
	 * sensor.
	 */
	if (sensor_sample_fetch(dev)) {
		return;
	}

	k_sem_give(&sem);
}

int app_sensor_init(void)
{
	int ret;
	dev = device_get_binding(DT_INST_0_NXP_FXOS8700_LABEL);

	if (dev == NULL) {
		return -ENODEV;
	}

	struct sensor_value attr = {
		.val1 = 6,
		.val2 = 250000,
	};

	ret = sensor_attr_set(dev, SENSOR_CHAN_ALL,
			SENSOR_ATTR_SAMPLING_FREQUENCY, &attr);
	if (ret != 0 ) {
		return ret;
	}

#ifdef CONFIG_FXOS8700_MOTION
	attr.val1 = 10;
	attr.val2 = 600000;
	ret = sensor_attr_set(dev, SENSOR_CHAN_ALL,
			    SENSOR_ATTR_SLOPE_TH, &attr);

	if (ret != 0 ) {
		return ret;
	}
#endif

	struct sensor_trigger trig = {
#ifdef CONFIG_FXOS8700_MOTION
		.type = SENSOR_TRIG_DELTA,
#else
		.type = SENSOR_TRIG_DATA_READY,
#endif
		.chan = SENSOR_CHAN_ACCEL_XYZ,
	};

	ret = sensor_trigger_set(dev, &trig, trigger_handler);
	if (ret != 0 ) {
		return ret;
	}
	return 0;
}

void app_sensor_loop(void)
{
	while (1) {
		k_sem_take(&sem, K_FOREVER);
		sensor_channel_get(dev, SENSOR_CHAN_ACCEL_XYZ, accel);
#if defined(CONFIG_FXOS8700_MODE_MAGN) || defined(CONFIG_FXOS8700_MODE_HYBRID)
		sensor_channel_get(dev, SENSOR_CHAN_MAGN_XYZ, magn);
#endif
#ifdef CONFIG_FXOS8700_TEMP
		sensor_channel_get(dev, SENSOR_CHAN_DIE_TEMP, &temp);
#endif
	}
}
```

## src/app_sensor.h
```c
#ifndef __APP_SENSOR_H__
#define __APP_SENSOR_H__

extern int app_sensor_init(void);
extern void app_sensor_loop(void);

#endif /* __APP_SENSOR_H__ */
```
